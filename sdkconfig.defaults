## sdkconfig.defaults
```kconfig
# Partition Table
CONFIG_PARTITION_TABLE_CUSTOM=y
CONFIG_PARTITION_TABLE_CUSTOM_FILENAME="manifests/partitions.csv"

# Compiler - optimize for performance
CONFIG_COMPILER_OPTIMIZATION_PERF=y

# Bluetooth - NimBLE
CONFIG_BT_ENABLED=y
CONFIG_BT_NIMBLE_ENABLED=y
CONFIG_BT_NIMBLE_MAX_CONNECTIONS=3

# HTTP Server - websocket support
CONFIG_HTTPD_WS_SUPPORT=y

# OTA - allow HTTP
CONFIG_OTA_ALLOW_HTTP=y

# LWIP
CONFIG_LWIP_SO_REUSE=y
CONFIG_LWIP_SO_REUSE_RXTOALL=y

# FreeRTOS
CONFIG_FREERTOS_HZ=1000
CONFIG_FREERTOS_USE_TRACE_FACILITY=y
CONFIG_FREERTOS_USE_STATS_FORMATTING_FUNCTIONS=y
CONFIG_FREERTOS_VTASKLIST_INCLUDE_COREID=y

# Flash - 4MB
CONFIG_ESPTOOLPY_FLASHSIZE_4MB=y

# Power Management
CONFIG_PM_ENABLE=y
CONFIG_PM_DFS_INIT_AUTO=y

# Wi-Fi - increased buffers
CONFIG_ESP_WIFI_STATIC_RX_BUFFER_NUM=25
CONFIG_ESP_WIFI_DYNAMIC_RX_BUFFER_NUM=128
CONFIG_ESP_WIFI_DYNAMIC_TX_BUFFER_NUM=128
CONFIG_ESP_WIFI_CSI_ENABLED=y
```

## sdkconfig.defaults.v1
```kconfig
# Hardware v1: ESP32 + HI229

# IMU sensor selection
CONFIG_IMU_SENSOR_HI229=y

# Bootloader - OTA rollback
CONFIG_BOOTLOADER_APP_ROLLBACK_ENABLE=y

# Flash mode - QIO for performance
CONFIG_ESPTOOLPY_FLASHMODE_QIO=y

# CPU frequency - 240MHz
CONFIG_ESP_DEFAULT_CPU_FREQ_MHZ_240=y

# BLE controller
CONFIG_BTDM_CTRL_BLE_MAX_CONN=3

# NimBLE flow control
CONFIG_BT_NIMBLE_HS_FLOW_CTRL=y

# FreeRTOS runtime stats
CONFIG_FREERTOS_GENERATE_RUN_TIME_STATS=y

# LWIP - increased UDP PCBs
CONFIG_LWIP_MAX_UDP_PCBS=512

# Wi-Fi SoftAP
CONFIG_ESP_WIFI_SOFTAP_SUPPORT=y

# PHY
CONFIG_ESP_PHY_REDUCE_TX_POWER=y

# IRAM optimization - reduce IRAM usage for ESP32
CONFIG_ESP_WIFI_IRAM_OPT=n
CONFIG_ESP_WIFI_RX_IRAM_OPT=n
```

## sdkconfig.defaults.v2
```kconfig
# Hardware v2: ESP32-S3 + BNO08X

# IMU sensor selection
CONFIG_IMU_SENSOR_BNO08X=y

# Wi-Fi SoftAP disabled
CONFIG_ESP_WIFI_SOFTAP_SUPPORT=n

# LWIP IRAM optimization
CONFIG_LWIP_IRAM_OPTIMIZATION=y

# NimBLE connection reattempt
CONFIG_BT_NIMBLE_ENABLE_CONN_REATTEMPT=y
CONFIG_BT_NIMBLE_MAX_CONN_REATTEMPT=3

# Console via USB-JTAG
CONFIG_ESP_CONSOLE_SECONDARY_USB_SERIAL_JTAG=y
```
